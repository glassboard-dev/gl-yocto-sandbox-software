## conf/bblayers.conf
```bitbake
# POKY_BBLAYERS_CONF_VERSION is increased each time build/conf/bblayers.conf
# changes incompatibly
POKY_BBLAYERS_CONF_VERSION = "2"

BBPATH = "${TOPDIR}"
BBFILES ?= ""

YOCTOROOT = "${@os.path.abspath(os.path.join("${TOPDIR}", os.pardir))}"

BBLAYERS ?= " \
  ${YOCTOROOT}/gl-yocto-sandbox-software/poky/meta \
  ${YOCTOROOT}/gl-yocto-sandbox-software/poky/meta-poky \
  ${YOCTOROOT}/gl-yocto-sandbox-software/poky/meta-yocto-bsp \
  ${YOCTOROOT}/gl-yocto-sandbox-software/meta-openembedded/meta-oe \
  ${YOCTOROOT}/gl-yocto-sandbox-software/meta-openembedded/meta-python \
  ${YOCTOROOT}/gl-yocto-sandbox-software/meta-atmel \
  "
```
